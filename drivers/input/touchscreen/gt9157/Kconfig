## drivers/input/touchscreen/gt9157/Kconfig
```kconfig
config TOUCHSCREEN_GT9157
	tristate "Goodix GT9157 Touchscreen Driver"
	help
	  Core driver for Goodix GT9157
```

## drivers/input/touchscreen/msg2xxx/Kconfig
```kconfig
config TOUCHSCREEN_CATA_MSG2238
	tristate "Mstar msg2238 Touchscreen Driver"
	select TOUCHSCREEN_GT9157
```

## drivers/video/rockchip/rk_epd/Kconfig
```kconfig
menuconfig EBC
	bool "eBook Controller"
	depends on FB_ROCKCHIP
	help
	eBook controller could help to driver the electronic ink screen.

choice
	prompt "Controller type select"
	depends on EBC
	help
	Two type support, hardware means that controller is embedded
	in cpu inside(exp RK3026), software means that using lcdc
	controller to simulate the eink timing(exp RK3188 & RK3288).
config HARDWARE_EBC
	bool "Hardware eBook controller"
config SOFTWARE_EBC
	bool "Software eBook controller"
endchoice

choice
	prompt "Eink panel select"
	depends on EBC
config V220_EINK_800X480
	bool "v220 eink_800X480"
config V110_EINK_800X600
	bool "v110 eink_800X600"
config V220_EINK_800X600
	bool "v220 eink_800X600"
config V220_EINK_1024X758
	bool "v220 eink_1024X758"
config V220_EINK_1024X768
	bool "v220 eink_1024X768"
config V220_EINK_1200X720
	bool "v220 eink_1200X720"
config V110_EINK_1200X825
	bool "v110 eink_1200X825"
config V220_EINK_1200X825
	bool "v220 eink_1200X825"
config V220_EINK_1200X825
	bool "v220 eink_1200X825"
config V220_EINK_1448x1072
	bool "v220 eink_1448x1072"
config V110_EINK_1600X1200
	bool "v110 eink_1600X1200"
config COLOR_EINK_800X600
	bool "color eink_800X600"
endchoice

choice
	prompt "Eink temperature sensor"
	depends on EBC
	default EPD_TPS65185_SENSOR
config EPD_LM75
	bool "LM75"
config EPD_NTC
	bool "NTC"
config EPD_G871
	bool "G871"
config EPD_TPS65185_SENSOR
	bool "Tps65185"
endchoice

choice
	prompt "Waveform stored position"
	depends on EBC
	default WAVEFORM_FROM_NAND_FLASH
config WAVEFORM_FROM_GPIO_SPI
	bool "gpio analog spi flash"
config WAVEFORM_FROM_RK_SPI
	bool "RK spi flash"
config WAVEFORM_FROM_NAND_FLASH
	bool "nand flash"
config WAVEFORM_FROM_WAVEFORM_FILE
	bool "ramdisk file"
endchoice

choice
	prompt "Waveform format"
	depends on EBC
config RKF_WAVEFORM
	bool "Rockchip simplified format"
config PVI_WAVEFORM
	bool "PVI original format"
endchoice


if PVI_WAVEFORM
choice
	prompt "GRAY16 refresh mode"
	default GRAY16_TO_GL16
config GRAY16_TO_GC16
	bool "Map to GC16"
config GRAY16_TO_GL16
	bool "Map to GL16"
config GRAY16_TO_GLR16
	bool "Map to GLR16"
config GRAY16_TO_GLD16
	bool "Map to GLD16"
endchoice

choice
	prompt "AUTO refresh mode"
	default AUTO_TO_GC16
config AUTO_TO_GC16
	bool "Map to GC16"
config AUTO_TO_GL16
	bool "Map to GL16"
config AUTO_TO_GLR16
	bool "Map to GLR16"
config AUTO_TO_GLD16
	bool "Map to GLD16"
endchoice

endif

config EBC_BOOT_ANI
	bool "bootup animation"
	depends on EBC
	help
	This could help to support a kernel bootup animation

if EBC_BOOT_ANI
	source "drivers/video/rockchip/rk_epd/bootani/Kconfig"
endif
```
